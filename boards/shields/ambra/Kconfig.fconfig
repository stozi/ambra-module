## boards/shields/ambra/Kconfig.fconfig
```kconfig
# Copyright (c) 2021 The ZMK Contributors
# SPDX-License-Identifier: MIT

if SHIELD_AMBRA_LEFT

config ZMK_KEYBOARD_NAME
    default "Ambra"

config ZMK_SPLIT_ROLE_CENTRAL
    default y

endif

if SHIELD_AMBRA_LEFT || SHIELD_AMBRA_RIGHT

config ZMK_SPLIT
    default y

endif
```

## boards/shields/ambra/Kconfig.shield
```kconfig
# Copyright (c) 2021 The ZMK Contributors
# SPDX-License-Identifier: MIT

config SHIELD_AMBRA_LEFT
    def_bool $(shields_list_contains,ambra_left)

config SHIELD_AMBRA_RIGHT
    def_bool $(shields_list_contains,ambra_right)
```
